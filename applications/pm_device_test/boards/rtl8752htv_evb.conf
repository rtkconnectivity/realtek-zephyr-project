## applications/pm_device_test/boards/rtl8752htv_evb.conf
```kconfig
CONFIG_HEAP_MEM_POOL_SIZE=1024
CONFIG_SHELL=y
CONFIG_PM=y
CONFIG_PM_DEVICE=y
CONFIG_LOG=y
CONFIG_LOG_PRINTK=y
CONFIG_LOG_MODE_DEFERRED=y
CONFIG_SERIAL=y
CONFIG_GPIO=y
CONFIG_DMA=y
CONFIG_COUNTER=y
CONFIG_PWM=y
CONFIG_SPI=y
CONFIG_RTC=y
CONFIG_I2C=y
CONFIG_RTC_BEE=y
CONFIG_RTC_ALARM=y
CONFIG_RTC_UPDATE=y
CONFIG_SENSOR=y
CONFIG_INPUT=y
CONFIG_INPUT_EVENT_DUMP=y
CONFIG_INPUT_BEE_KSCAN=y
CONFIG_BEE_KEYSCAN_AUTOSCAN_MODE=n
CONFIG_ADC=y
CONFIG_ADC_ASYNC=y
```

## applications/pm_device_test/dts/bindings/test-spi-loopback.yaml
```yaml
#
# Copyright (c) 2022 Kumar Gala <galak@kernel.org>
#
# SPDX-License-Identifier: Apache-2.0
#

description: |
    This binding provides resources required to build and run the
    samples/test_rtl8773g_evb in Zephyr.

compatible: "test-spi-loopback"

include: [spi-device.yaml]
```

## subsys/dfu/Kconfig
```kconfig
# Copyright (c) 2025 Realtek Semiconductor Corp.
# SPDX-License-Identifier: Apache-2.0

config REALTEK_OTA
	bool "Realtek BLE OTA"
    select REALTEK_DFU
	default n

module = REALTEK_OTA
module-str = "REALTEK OTA"
source "${ZEPHYR_BASE}/subsys/logging/Kconfig.template.log_config"

if REALTEK_OTA

choice OTA_MODE
	prompt "BLE OTA mode Selection"
	default SILENT_MODE
	help
	  Select the BLE OTA mode.

config SILENT_MODE
	bool "silent mode"

config NORMAL_MODE
	bool "normal mode"

endchoice

endif

config REALTEK_DFU
    bool "Realtek DFU"

module = REALTEK_DFU
module-str = "REALTEK DFU"
source "${ZEPHYR_BASE}/subsys/logging/Kconfig.template.log_config"
```
