## west.yml
```yaml
manifest:
  self:
    path: realtek-zephyr-project
    west-commands: tool/west-commands.yml

  remotes:
    - name: rtkconnectivity
      url-base: https://github.com/rtkconnectivity
    - name: zephyr
      url-base: https://github.com/zephyrproject-rtos

  defaults:
    remote: rtkconnectivity

  projects:
    - name: zephyr
      remote: rtkconnectivity
      revision: pull/314/head
      import:
        name-allowlist:
          - cmsis
          - cmsis_6
          - hal_realtek
          - mbedtls
          - tf-psa-crypto
          - segger
          - cmsis-dsp
          - cmsis-nn
          - mldsa-native
          - littlefs
          - fatfs
          - mcuboot
          - zcbor
          - mipi-sys-t

    #
    # Realtek based overrides of hal_realtek modules
    #
    - name: hal_realtek
      remote: rtkconnectivity
      revision: pull/21/head
      path: modules/hal/realtek
      groups:
        - hal
```
