## west.yml
```yaml
manifest:
  self:
    path: realtek-zephyr-project
    west-commands: tool/west-commands.yml

  remotes:
    - name: rtkconnectivity
      url-base: https://github.com/rtkconnectivity
    - name: zephyr
      url-base: https://github.com/zephyrproject-rtos
    - name: pankore
      url-base: https://github.com/pankore

  defaults:
    remote: rtkconnectivity

  group-filter: [-matter]

  projects:
    - name: zephyr
      remote: rtkconnectivity
      revision: realtek-main-v4.4
      import:
        name-allowlist:
          - cmsis
          - cmsis_6
          - hal_realtek
          - mbedtls
          - openthread
          - tf-psa-crypto
          - segger
          - cmsis-dsp
          - cmsis-nn
          - mldsa-native
          - littlefs
          - fatfs
          - mcuboot
          - zcbor
          - mipi-sys-t

    #
    # Realtek based overrides of hal_realtek, mcuboot and tf-psa-crypto modules
    #
    - name: hal_realtek
      remote: rtkconnectivity
      revision: hal_realtek_v4.4
      path: modules/hal/realtek
      groups:
        - hal

    - name: mcuboot
      remote: rtkconnectivity
      repo-path: zephyr-mcuboot
      revision: v4.4-bee
      path: bootloader/mcuboot
      groups:
        - bootloader

    - name: tf-psa-crypto
      remote: rtkconnectivity
      repo-path: zephyr-tf-psa-crypto
      revision: v4.4.0-bee-psa-accelerators
      path: modules/crypto/tf-psa-crypto
      groups:
        - crypto

    - name: connectedhomeip
      remote: pankore
      revision: rtl8777g_zephyr_dev
      path: modules/lib/connectedhomeip
      groups:
        - matter
```
